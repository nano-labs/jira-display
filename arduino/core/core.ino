
#include <SPI.h>
#include <Wire.h>
#include <Adafruit_GFX.h>
#include <Adafruit_SSD1306.h>

#define OLED_RESET 4
Adafruit_SSD1306 display(OLED_RESET);

static const unsigned char PROGMEM ca_logo[128 * 32 / 8] =
{
B00000000, B00000000, B00000000, B00000000, B00000000, B00000000, B00000000, B00000000, B00000000, B00000000, B00000000, B00000000, B00000000, B00000000, B00000000, B00000000,
B00000000, B00000000, B00000000, B00000000, B00000000, B00000000, B00000000, B00000000, B00000000, B00000000, B00000000, B00000000, B00000000, B00000000, B00000000, B00000000,
B00000000, B00000000, B00000000, B00000000, B00000000, B00000000, B00000000, B00000000, B00000000, B00000000, B00000000, B00000000, B00000000, B00000000, B00000000, B00000000,
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B00000000, B00000000, B00000000, B00000000, B00000000, B00000000, B00000000, B00000000, B00000000, B00000000, B00000000, B00000000, B00000000, B00000000, B00000000, B00000000
};

// constants won't change. They're used here to set pin numbers:
const int prevButtonPin = 2;     // the number of the pushbutton pin
const int nextButtonPin = 4;     // the number of the pushbutton pin
const int startButtonPin = 7;     // the number of the pushbutton pin

const int ledPin =  13;      // the number of the LED pin

unsigned char image_buffer[128*32 / 8];

int inByte = 0;
int prevButtonState = 0;         // variable for reading the pushbutton status
int prevTriggered = 0;
int prevPushed = 0;
int nextButtonState = 0;         // variable for reading the pushbutton status
int nextTriggered = 0;
int nextPushed = 0;
int startButtonState = 0;         // variable for reading the pushbutton status
int startTriggered = 0;
int startPushed = 0;
int ledOn = 0;

void setup() {
  display.begin(SSD1306_SWITCHCAPVCC, 0x3C);  // initialize with the I2C addr 0x3C (for the 128x32)
  display.clearDisplay();
  display.drawBitmap(0, 0, ca_logo, 128, 32, WHITE);
  display.display();

  // start serial port at 9600 bps:
//  Serial.begin(9600);
  Serial.begin(57600);
  while (!Serial) {
    ; // wait for serial port to connect. Needed for native USB port only
  }
  establishContact();  // send a byte to establish contact until receiver responds

  
  pinMode(ledPin, OUTPUT);
  pinMode(prevButtonPin, INPUT);
  pinMode(nextButtonPin, INPUT);
  pinMode(startButtonPin, INPUT);

}

void toggleLed() {
    if (ledOn == 0) {
      digitalWrite(ledPin, HIGH);
      ledOn = 1;
    } else {
      digitalWrite(ledPin, LOW);
      ledOn = 0;
    };
}

void establishContact() {
}

int readBinaryString(char *s) {
  int result = 0;
  while(*s) {
    result <<= 1;
    if(*s++ == '1') result |= 1;
  }
  return result;
}

void loop() {
  prevButtonState = digitalRead(prevButtonPin);
  if (prevButtonState == HIGH) {
    prevTriggered = 1;
  } else {
    if (prevTriggered == 1) {
      prevPushed = 1;
    }
  }
  nextButtonState = digitalRead(nextButtonPin);
  if (nextButtonState == HIGH) {
    nextTriggered = 1;
  } else {
    if (nextTriggered == 1) {
      nextPushed = 1;
    }
  }
  startButtonState = digitalRead(startButtonPin);
  if (startButtonState == HIGH) {
    startTriggered = 1;
  } else {
    if (startTriggered == 1) {
      startPushed = 1;
    }
  }
  if (nextPushed == 1 || prevPushed == 1 || startPushed == 1) {
    delay(200);
  }

  if (prevPushed == 1) {
    Serial.println("prev");
    toggleLed();
    prevPushed = 0;
    prevTriggered = 0;
  };
  if (nextPushed == 1) {
    Serial.println("next");
    toggleLed();
    nextPushed = 0;
    nextTriggered = 0;
  };
  if (startPushed == 1) {
    Serial.println("start");
    toggleLed();
    startPushed = 0;
    startTriggered = 0;
  };

  inByte = Serial.read();
  if (inByte == 73) {
    Serial.readBytes(image_buffer, 512);
    Serial.println("end_image");
    display.clearDisplay();
    display.drawBitmap(0, 0, image_buffer, 128, 32, WHITE);
    display.display();
  }
}
